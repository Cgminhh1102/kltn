## CMakeLists.txt
```
#
# Copyright (c) 2020 Nordic Semiconductor ASA
#
# SPDX-License-Identifier: LicenseRef-Nordic-5-Clause
#
cmake_minimum_required(VERSION 3.20.0)

find_package(Zephyr REQUIRED HINTS $ENV{ZEPHYR_BASE})
project(chat_2)

# NORDIC SDK APP START
target_sources(app PRIVATE
	src/main.c
	src/model_handler.c
	src/chat_cli.c)
target_include_directories(app PRIVATE include)
# NORDIC SDK APP END
```

## prj.conf
```kconfig
#
# Copyright (c) 2020 Nordic Semiconductor ASA
#
# SPDX-License-Identifier: LicenseRef-Nordic-5-Clause
#
CONFIG_NCS_SAMPLES_DEFAULTS=y

# Deferred logging helps improve LPN power consumption
# when friendship is established.
CONFIG_LOG_MODE_DEFERRED=y

# General configuration
CONFIG_NCS_APPLICATION_BOOT_BANNER_STRING="DSDV ROUTING NODE"
CONFIG_SYSTEM_WORKQUEUE_STACK_SIZE=2048
CONFIG_FLASH=y
CONFIG_FLASH_MAP=y
CONFIG_NVS=y
CONFIG_SETTINGS=y
CONFIG_NVS_LOOKUP_CACHE=y
CONFIG_SETTINGS_NVS_NAME_CACHE=y
CONFIG_HWINFO=y
CONFIG_DK_LIBRARY=y
CONFIG_PM_PARTITION_SIZE_SETTINGS_STORAGE=0x8000

# Bluetooth configuration
CONFIG_BT=y
CONFIG_BT_DEVICE_NAME="DSDV ROUTING NODE"
CONFIG_BT_L2CAP_TX_BUF_COUNT=12
CONFIG_BT_OBSERVER=y
CONFIG_BT_PERIPHERAL=y
CONFIG_BT_SETTINGS=y

# Disable unused Bluetooth features
CONFIG_BT_CTLR_LE_ENC=n
CONFIG_BT_PHY_UPDATE=n
CONFIG_BT_CTLR_CHAN_SEL_2=n
CONFIG_BT_CTLR_MIN_USED_CHAN=n
CONFIG_BT_CTLR_PRIVACY=n

# Bluetooth Mesh configuration
CONFIG_BT_MESH=y
CONFIG_BT_MESH_RELAY=y
CONFIG_BT_MESH_FRIEND=y
CONFIG_BT_MESH_RX_SEG_MAX=20
CONFIG_BT_MESH_TX_SEG_MAX=20
CONFIG_BT_MESH_SEG_BUFS=20
CONFIG_BT_MESH_TX_SEG_MSG_COUNT=6
CONFIG_BT_MESH_RX_SEG_MSG_COUNT=6
CONFIG_BT_MESH_MSG_CACHE_SIZE=40
CONFIG_BT_MESH_ADV_BUF_COUNT=12
CONFIG_BT_MESH_PB_GATT=y
CONFIG_BT_MESH_GATT_PROXY=y
CONFIG_BT_MESH_DK_PROV=y

# Enable Bluetooth Mesh models debug logs (chỉ giữ warning level để giảm nhiễu)
CONFIG_BT_MESH_LOG_LEVEL_WRN=y

# Enable Shell module and use UART as a backend
CONFIG_SHELL=y
CONFIG_SHELL_BACKEND_SERIAL=y
CONFIG_FLASH_SHELL=n

CONFIG_LOG_BACKEND_RTT=n

# TX Power configuration for linear topology testing
# Use low power to create controlled short-range connections
CONFIG_BT_CTLR_TX_PWR_MINUS_40=y
# Giữ log level thấp để output sạch (chỉ hiển thị log từ app)
CONFIG_BT_MESH_MODEL_LOG_LEVEL_WRN=y
# Tắt debug log của bt_mesh_access để giảm nhiễu
CONFIG_BT_MESH_ACCESS_LOG_LEVEL_WRN=y

# ADC configuration for battery voltage measurement
CONFIG_ADC=y
CONFIG_ADC_NRFX_SAADC=y
```

## boards/nrf54l15dk_nrf54l15_cpuapp.overlay
```dts
/*
 * Copyright (c) 2025
 * SPDX-License-Identifier: LicenseRef-Nordic-5-Clause
 */

/ {
	zephyr,user {
		io-channels = <&adc 0>;
	};
};

&adc {
	#address-cells = <1>;
	#size-cells = <0>;
	status = "okay";
	
	channel@0 {
		reg = <0>;
		zephyr,gain = "ADC_GAIN_1_4";
		zephyr,reference = "ADC_REF_INTERNAL";
		zephyr,acquisition-time = <ADC_ACQ_TIME_DEFAULT>;
		zephyr,input-positive = <NRF_SAADC_VDD>;
		zephyr,resolution = <14>;
	};
};
```

## src/main.c
```c
/*
 * Copyright (c) 2019 Nordic Semiconductor ASA
 *
 * SPDX-License-Identifier: LicenseRef-Nordic-5-Clause
 */

/** @file
 *  @brief Nordic Mesh light sample
 */
#include <zephyr/bluetooth/bluetooth.h>
#include <bluetooth/mesh/models.h>
#include <bluetooth/mesh/dk_prov.h>
#include <dk_buttons_and_leds.h>
#include "model_handler.h"

#include <zephyr/logging/log.h>
LOG_MODULE_REGISTER(chat, CONFIG_LOG_DEFAULT_LEVEL);
static void bt_ready(int err)
{
	if (err) {
		printk("Bluetooth init failed (err %d)\n", err);
		return;
	}

	printk("Bluetooth initialized\n");
	err = dk_leds_init();
	if (err) {
		printk("Initializing LEDs failed (err %d)\n", err);
		return;
	}

	err = dk_buttons_init(NULL);
	if (err) {
		printk("Initializing buttons failed (err %d)\n", err);
		return;
	}

	err = bt_mesh_init(bt_mesh_dk_prov_init(), model_handler_init());
	if (err) {
		printk("Initializing mesh failed (err %d)\n", err);
		return;
	}

	if (IS_ENABLED(CONFIG_SETTINGS)) {
		settings_load();
	}

	/* This will be a no-op if settings_load() loaded provisioning info */
	bt_mesh_prov_enable(BT_MESH_PROV_ADV | BT_MESH_PROV_GATT);

	printk("Mesh initialized\n");
}

int main(void)
{
	int err;

	printk("Initializing...\n");

	err = bt_enable(bt_ready);
	if (err) {
		printk("Bluetooth init failed (err %d)\n", err);
	}

	return 0;
}
```

## include/battery_adc.h
```c
/*
 * Copyright (c) 2025
 * SPDX-License-Identifier: LicenseRef-Nordic-5-Clause
 */

#ifndef BATTERY_ADC_H__
#define BATTERY_ADC_H__

#include <stdint.h>

/**
 * @brief Initialize ADC for battery voltage measurement
 * 
 * Configures ADC channel to read battery voltage through voltage divider.
 * For nRF54L15, typical setup:
 * - ADC input: AIN0 (P0.04) or VDD internal
 * - Reference: Internal 0.6V
 * - Gain: 1/6 for measuring up to 3.6V
 * - Resolution: 12-bit
 * 
 * @return 0 on success, negative errno on failure
 */
int battery_adc_init(void);

/**
 * @brief Read battery voltage in millivolts
 * 
 * Performs ADC conversion and returns battery voltage.
 * Typical range: 1800 mV (empty) to 3300 mV (full) for Li-Ion/LiPo
 * 
 * @param[out] voltage_mv Battery voltage in millivolts
 * 
 * @return 0 on success, negative errno on failure
 */
int battery_adc_read_mv(uint16_t *voltage_mv);

/**
 * @brief Get battery percentage from voltage
 * 
 * Converts battery voltage to percentage using linear approximation:
 * - 3.3V = 100%
 * - 3.0V = 50%
 * - 2.7V = 20%
 * - 2.4V = 5%
 * - <2.4V = 0%
 * 
 * @param voltage_mv Battery voltage in millivolts
 * 
 * @return Battery percentage (0-100)
 */
uint8_t battery_voltage_to_percent(uint16_t voltage_mv);

/**
 * @brief Get battery percentage directly
 * 
 * Reads ADC and converts to percentage in one call.
 * Returns 0 if ADC read fails.
 * 
 * @return Battery percentage (0-100)
 */
uint8_t battery_get_percentage(void);

#endif /* BATTERY_ADC_H__ */
```

## include/chat_cli.h
```c
/*
 * Copyright (c) 2020 Nordic Semiconductor ASA
 *
 * SPDX-License-Identifier: LicenseRef-Nordic-5-Clause
 */

/**
 * @file chat_cli.h
 * @defgroup bt_mesh_chat_cli Bluetooth Mesh Chat Client Model API
 * @{
 * @brief API for the Bluetooth Mesh Chat Client model with DSDV routing
 * 
 * This model implements:
 * - DSDV (Destination-Sequenced Distance-Vector) proactive routing protocol
 * - Network metrics collection (battery, RSSI, congestion, neighbor quality)
 * - Automatic expired route filtering (45s timeout)
 * - Remote structure querying
 */

#ifndef BT_MESH_CHAT_CLI_H__
#define BT_MESH_CHAT_CLI_H__

#include <zephyr/bluetooth/mesh.h>
#include <bluetooth/mesh/model_types.h>

#ifdef __cplusplus
extern "C" {
#endif

/* ============================================================================
 * MODEL IDENTIFICATION
 * ============================================================================ */

/** Company ID of the Bluetooth Mesh Chat Client model. */
#define BT_MESH_CHAT_CLI_VENDOR_COMPANY_ID    CONFIG_BT_COMPANY_ID_NORDIC

/** Model ID of the Bluetooth Mesh Chat Client model. */
#define BT_MESH_CHAT_CLI_VENDOR_MODEL_ID      0x000A

/* ============================================================================
 * OPCODES - Mesh message operation codes
 * ============================================================================ */

/** Opcode: Metrics acknowledgment packet */
#define BT_MESH_CHAT_CLI_OP_METRICS_ACK BT_MESH_MODEL_OP_3(0x0F, \
                                       BT_MESH_CHAT_CLI_VENDOR_COMPANY_ID)
/** Opcode: DSDV HELLO packet (neighbor discovery + RSSI) */
#define BT_MESH_CHAT_CLI_OP_DSDV_HELLO BT_MESH_MODEL_OP_3(0x12, \
									   BT_MESH_CHAT_CLI_VENDOR_COMPANY_ID)

/** Opcode: DSDV UPDATE packet (routing table exchange) */
#define BT_MESH_CHAT_CLI_OP_DSDV_UPDATE BT_MESH_MODEL_OP_3(0x13, \
									   BT_MESH_CHAT_CLI_VENDOR_COMPANY_ID)

/** Opcode: DSDV DATA packet (end-to-end data with metrics) */
#define BT_MESH_CHAT_CLI_OP_DSDV_DATA BT_MESH_MODEL_OP_3(0x14, \
									   BT_MESH_CHAT_CLI_VENDOR_COMPANY_ID)

/** Opcode: Relay metrics packet (metrics from intermediate nodes) */
#define BT_MESH_CHAT_CLI_OP_RELAY_METRICS BT_MESH_MODEL_OP_3(0x15, \
									   BT_MESH_CHAT_CLI_VENDOR_COMPANY_ID)

/** Opcode: Structure request packet (query routing table) */
#define BT_MESH_CHAT_CLI_OP_STRUCTURE_REQUEST BT_MESH_MODEL_OP_3(0x16, \
									   BT_MESH_CHAT_CLI_VENDOR_COMPANY_ID)

/* ============================================================================
 * MESSAGE LENGTH CONSTANTS
 * ============================================================================ */
									   
#define BT_MESH_CHAT_CLI_MSG_LEN_DSDV_HELLO 8                /**< HELLO packet size */
#define BT_MESH_CHAT_CLI_MSG_LEN_DSDV_UPDATE_MIN 8           /**< Minimum UPDATE packet size */
// #define BT_MESH_CHAT_CLI_MSG_LEN_NETWORK_METRICS 15       /**< DEPRECATED: Legacy standalone metrics */
#define BT_MESH_CHAT_CLI_MSG_LEN_METRICS_ACK 8               /**< Metrics ACK packet size */
#define BT_MESH_CHAT_CLI_MSG_LEN_RELAY_METRICS sizeof(struct relay_metrics_packet)  /**< Relay metrics size */
#define BT_MESH_CHAT_CLI_MSG_LEN_DSDV_DATA_MAX 128           /**< Maximum DATA packet size */

/* ============================================================================
 * DATA STRUCTURES - Packet formats and routing table entries
 * ============================================================================ */

/**
 * @brief Per-neighbor RSSI tracking entry
 * 
 * Stores RSSI measurement for each neighbor to enable link quality
 * assessment and route selection.
 */
struct neighbor_rssi_entry {
	uint16_t addr;  /**< Neighbor node address */
	int8_t rssi;    /**< RSSI value in dBm */
} __packed;

/** Maximum number of neighbors to include in metrics packet */
#define MAX_NEIGHBORS_IN_METRICS 8

/**
 * @brief Network metrics packet structure
 * 
 * Contains comprehensive network performance metrics from a node:
 * - Link quality (RSSI to target and all neighbors)
 * - Network load (congestion percentage)
 * - Packet delivery info (TTL, hop count)
 */
struct bt_mesh_network_metrics
{
	uint16_t src_addr;      /**< Source node address */
	uint16_t about_addr;    /**< Target node address (for directed metrics) */
	uint32_t timestamp;     /**< Metric collection timestamp (ms) */
	int8_t rssi_dbm;        /**< RSSI to about_addr in dBm */
	uint8_t _padding;       /**< Padding for alignment */
	uint16_t congestion;    /**< Congestion level (failures per 1000 sends) */
	uint8_t initial_ttl;    /**< TTL used for packet transmission */
	uint8_t hop_count;      /**< Number of hops from source */
	uint8_t request_ack;    /**< 1 = request acknowledgment, 0 = no ACK needed */
	uint8_t neighbor_count; /**< Number of valid entries in neighbor_rssi[] */
	struct neighbor_rssi_entry neighbor_rssi[MAX_NEIGHBORS_IN_METRICS]; /**< All neighbor link qualities */
}__packed;

/**
 * @brief Metrics acknowledgment packet
 * 
 * Sent by destination to confirm metrics packet delivery.
 * Enables RTT (Round Trip Time) calculation.
 */
struct bt_mesh_metrics_ack{
	uint16_t src_addr;           /**< Original sender address */
	uint32_t original_timestamp; /**< Echo of original timestamp for RTT calculation */
	uint16_t padding;            /**< Padding to reach 8 bytes */
} __packed;

/**
 * @brief DSDV routing table entry
 * 
 * Stores routing information for one destination in the network.
 * Updated when receiving HELLO or UPDATE packets.
 */
struct dsdv_route_entry {
	uint16_t dest;               /**< Destination node address */
	uint16_t next_hop;           /**< Next hop node address to reach dest */
	uint8_t hop_count;           /**< Number of hops to destination (0xFF = invalidation) */
	uint32_t seq_num;            /**< Sequence number from destination (freshness / odd=invalid) */
	uint32_t last_update_time;   /**< Last successful update time (ms) */
	uint8_t tentative;           /**< 1 = route learned without confirmed HELLO yet */
	uint8_t fail_streak;         /**< Consecutive send failures via this route */
	uint8_t dirty;               /**< 1 = needs to be advertised in next incremental UPDATE */
	uint8_t _pad;                /**< Padding for alignment */
}__packed;

/**
 * @brief DSDV HELLO packet structure
 * 
 * Broadcast every ~5 seconds for neighbor discovery.
 * Receivers create 1-hop routes and measure RSSI.
 */
struct dsdv_hello {
    uint16_t src;       /**< Source node address */
    uint32_t seq_num;   /**< Source's sequence number (even numbers only) */
    uint16_t flags;     /**< Reserved for future use */
} __packed;

/**
 * @brief DSDV UPDATE packet header
 * 
 * Followed by num_entries route entries.
 * Shares routing table with neighbors for multi-hop routing.
 */
struct dsdv_update_header {
	uint16_t src;         /**< Source node address */
	uint8_t num_entries;  /**< Number of route entries following this header */
	uint8_t flags;        /**< Reserved flags */
} __packed;

/**
 * @brief DSDV UPDATE route entry payload
 * 
 * Sent in UPDATE packets. Does NOT include next_hop because:
 * - Receiver will set next_hop = sender_address
 * - Including next_hop would cause routing errors (transitive next_hop)
 */
struct dsdv_update_entry {
	uint16_t dest;        /**< Destination node address */
	uint8_t hop_count;    /**< Number of hops from sender to dest */
	uint32_t seq_num;     /**< Sequence number from destination */
	uint8_t padding;      /**< Padding for alignment */
} __packed;

/** Maximum number of nodes in path vector for DATA packets */
#define MAX_PATH_NODES 8

/**
 * @brief DSDV DATA packet structure
 * 
 * End-to-end data delivery with embedded metrics and path tracking.
 * Supports relay metrics collection for network analysis.
 */
struct dsdv_data_packet {
	uint16_t src;
	uint16_t dest;
	uint32_t seq_num;
	uint8_t hop_count;
	uint8_t path_len;
	uint16_t path_nodes[MAX_PATH_NODES];
	
	// Sequential mode: Only source metrics in main packet
	struct bt_mesh_network_metrics metrics;
	uint8_t collect_relay_metrics;  // Flag: 1 = relays send metrics separately
} __packed;

// Relay metrics packet (sent separately by each relay)
struct relay_metrics_packet {
	uint16_t original_src;
	uint32_t original_seq;
	uint16_t relay_addr;
	struct bt_mesh_network_metrics relay_metrics;
} __packed;

// Network structure request packet (destination will print its routing table)
struct structure_request_packet {
	uint16_t requester_addr;
	uint32_t request_seq;
} __packed;

/* Forward declaration of the Bluetooth Mesh Chat Client model context. */
struct bt_mesh_chat_cli;

/* .. include_startingpoint_chat_cli_rst_2 */
/** @def BT_MESH_MODEL_CHAT_CLI
 *
 * @brief Bluetooth Mesh Chat Client model composition data entry.
 *
 * @param[in] _chat Pointer to a @ref bt_mesh_chat_cli instance.
 */
#define BT_MESH_MODEL_CHAT_CLI(_chat)                                          \
		BT_MESH_MODEL_VND_CB(BT_MESH_CHAT_CLI_VENDOR_COMPANY_ID,       \
			BT_MESH_CHAT_CLI_VENDOR_MODEL_ID,                      \
			_bt_mesh_chat_cli_op, &(_chat)->pub,                   \
			BT_MESH_MODEL_USER_DATA(struct bt_mesh_chat_cli,       \
						_chat),                        \
			&_bt_mesh_chat_cli_cb)
/* .. include_endpoint_chat_cli_rst_2 */

/** Bluetooth Mesh Chat Client model handlers. */
struct bt_mesh_chat_cli_handlers {
	/** @brief Called after the node has been provisioned, or after all
	 * mesh data has been loaded from persistent storage.
	 *
	 * @param[in] cli Chat Client instance that has been started.
	 */
	void (*const start)(struct bt_mesh_chat_cli *chat);

	/** @brief Handler for a network metrics message.
	 *
	 * @param[in] cli Chat client instance that received the message.
	 * @param[in] ctx Context of the incoming message.
	 * @param[in] metrics Pointer to the network metrics data.
	 */
	void (*const network_metrics)(struct bt_mesh_chat_cli *chat,
				       struct bt_mesh_msg_ctx *ctx,
				       const struct bt_mesh_network_metrics *metrics);
	
	/** @brief Handler for metrics ACK message.
	 * @param[in] chat Chat client instance.
	 * @param[in] ctx Context of the incoming message.
	 * @param[in] ack Metrics ACK data.
 */
	void (*const metrics_ack)(struct bt_mesh_chat_cli *chat,
				  struct bt_mesh_msg_ctx *ctx,
				  const struct bt_mesh_metrics_ack *ack);
};

/* .. include_startingpoint_chat_cli_rst_3 */
/**
 * Bluetooth Mesh Chat Client model context.
 */
struct bt_mesh_chat_cli {
	/** Access model pointer. */
	const struct bt_mesh_model *model;
	/** Publish parameters. */
	struct bt_mesh_model_pub pub;
	/** Publication message. */
	struct net_buf_simple pub_msg;
	/** Publication message buffer. */
	uint8_t buf[BT_MESH_MODEL_BUF_LEN(BT_MESH_CHAT_CLI_OP_DSDV_UPDATE,
					  BT_MESH_CHAT_CLI_MSG_LEN_DSDV_DATA_MAX)];
	/** Handler function structure. */
	const struct bt_mesh_chat_cli_handlers *handlers;
};
/* .. include_endpoint_chat_cli_rst_3 */

/** @brief Send network metrics to specified destination.
 *
 * @param[in] chat Chat Client model instance to send the message.
 * @param[in] addr Address of the destination node.
 * @param[in] metrics Pointer to network metrics data to send.
 *
 * @retval 0 Successfully sent the message.
 * @retval -EINVAL The model is not bound to an application key.
 * @retval -EAGAIN The device has not been provisioned.
 */
/** @brief set target node for metrics collection.
 *
 * @param[in] target_addr Address of target node for metrics.
 */
void bt_mesh_chat_cli_set_metrics_target(uint16_t target_addr);

/** @brief Get neighbor RSSI statistics.
 *
 * Returns the number of neighbors with RSSI data.
 * Fills the provided arrays with neighbor addresses and RSSI values.
 *
 * @param[out] addrs Array to store neighbor addresses (must have space for 16).
 * @param[out] rssi Array to store RSSI values (must have space for 16).
 * @param[in] max_count Maximum number of entries to return.
 *
 * @return Number of neighbors returned.
 */
int bt_mesh_chat_cli_get_neighbor_rssi(uint16_t *addrs, int8_t *rssi, int max_count);

/** @brief Send network metrics immediately via DSDV.
 *
 * Attempts to find a DSDV route and unicast a metrics packet to @p addr.
 * If no route is found, returns an error and does not publish/broadcast.
 *
 * @param[in] chat Chat Client model instance.
 * @param[in] addr Destination unicast address.
 *
 * @retval 0 on success.
 * @retval -EINVAL Invalid args or addr.
 * @retval -ENOENT No route to destination.
 */
int bt_mesh_chat_cli_metrics_send(struct bt_mesh_chat_cli *chat, uint16_t addr);

/**
 * @brief Clear route metrics history
 *
 * Clears the stored route metrics history table at destination node.
 */
void bt_mesh_chat_cli_clear_route_history(void);

/**
 * @brief Display route metrics history
 *
 * Displays the stored route metrics comparison table.
 */
void bt_mesh_chat_cli_show_route_history(void);

/**
 * @brief Request network structure from a node
 *
 * Sends a structure request to the specified node. The target node will
 * reply with its complete DSDV routing table, showing all known nodes,
 * their next_hop addresses, hop counts, and RSSI values.
 *
 * @param[in] chat Chat Client model instance.
 * @param[in] dest Destination unicast address to request structure from.
 *
 * @retval 0 on success.
 * @retval -EINVAL Invalid arguments or destination address.
 * @retval -ENOENT No route to destination.
 */
int bt_mesh_chat_cli_structure_request(struct bt_mesh_chat_cli *chat, uint16_t dest);

/** @cond INTERNAL_HIDDEN */
extern const struct bt_mesh_model_op _bt_mesh_chat_cli_op[];
extern const struct bt_mesh_model_cb _bt_mesh_chat_cli_cb;
/** @endcond */

#ifdef __cplusplus
}
#endif

#endif /* BT_MESH_CHAT_CLI_H__ */

/** @} */
```

## include/model_handler.h
```c
/*
 * Copyright (c) 2020 Nordic Semiconductor ASA
 *
 * SPDX-License-Identifier: LicenseRef-Nordic-5-Clause
 */

/**
 * @file
 * @brief Model handler
 */

#ifndef MODEL_HANDLER_H__
#define MODEL_HANDLER_H__

#include <zephyr/bluetooth/mesh.h>

#ifdef __cplusplus
extern "C" {
#endif

const struct bt_mesh_comp *model_handler_init(void);

/** @brief Blink LED to indicate packet received
 *  @param count Number of blinks
 */
void mesh_led_blink(int count);

/** @brief Store relay metrics to cache
 *  @param relay_addr Address of relay node
 *  @param original_src Original packet source
 *  @param original_seq Original packet sequence
 *  @param metrics Relay node metrics to store
 */
void store_relay_metrics(uint16_t relay_addr, 
                        uint16_t original_src,
                        uint32_t original_seq,
                        const struct bt_mesh_network_metrics *metrics);

#ifdef __cplusplus
}
#endif

#endif /* MODEL_HANDLER_H__ */
```

## src/battery_adc.c
```c
/*
 * Copyright (c) 2025
 * SPDX-License-Identifier: LicenseRef-Nordic-5-Clause
 */

#include "battery_adc.h"
#include <zephyr/device.h>
#include <zephyr/drivers/adc.h>
#include <zephyr/logging/log.h>

LOG_MODULE_REGISTER(battery_adc, LOG_LEVEL_DBG);

// ADC configuration for nRF54L15
#define ADC_DEVICE_NODE DT_NODELABEL(adc)
#define ADC_RESOLUTION 14
#define ADC_GAIN ADC_GAIN_1_4
#define ADC_REFERENCE ADC_REF_INTERNAL
#define ADC_ACQUISITION_TIME ADC_ACQ_TIME_DEFAULT
#define ADC_CHANNEL_ID 0

// Pin selection based on device tree visualization:
// ADC channels map to PORT 2 (P1.xx):
// - AIN1 → P1.05 (recommended for battery)
// NOTE: Pin configuration is done in device tree overlay file.
// See: boards/nrf54l15dk_nrf54l15_cpuapp.overlay

static const struct device *adc_dev;
static struct adc_channel_cfg channel_cfg = {
	.gain = ADC_GAIN,
	.reference = ADC_REFERENCE,
	.acquisition_time = ADC_ACQUISITION_TIME,
	.channel_id = ADC_CHANNEL_ID,
	// Note: input_positive is configured in device tree overlay
};

static int16_t sample_buffer;
static struct adc_sequence sequence = {
	.buffer = &sample_buffer,
	.buffer_size = sizeof(sample_buffer),
	.resolution = ADC_RESOLUTION,
};

int battery_adc_init(void)
{
	int err;

	adc_dev = DEVICE_DT_GET(ADC_DEVICE_NODE);
	if (!device_is_ready(adc_dev)) {
		LOG_ERR("ADC device not ready");
		return -ENODEV;
	}

	err = adc_channel_setup(adc_dev, &channel_cfg);
	if (err) {
		LOG_ERR("ADC channel setup failed: %d", err);
		return err;
	}

	sequence.channels = BIT(ADC_CHANNEL_ID);

	LOG_INF("Battery ADC initialized (channel %d, gain 1/6, ref internal)",
		ADC_CHANNEL_ID);

	return 0;
}

int battery_adc_read_mv(uint16_t *voltage_mv)
{
	int err;

	if (!adc_dev) {
		LOG_ERR("ADC not initialized");
		return -ENODEV;
	}

	err = adc_read(adc_dev, &sequence);
	if (err) {
		LOG_ERR("ADC read failed: %d", err);
		return err;
	}

	// Convert ADC value to millivolts
	// Reference: 0.6V internal
	// Gain: 1/6 (can measure up to 3.6V)
	// Resolution: 12-bit (0-4095)
	
	int32_t val_mv = sample_buffer;
	
	// Formula: V = (ADC_value * V_ref * gain_multiplier) / ADC_max
	// For gain 1/6: actual input = measured * 6
	// V_ref = 600 mV (internal reference)
	val_mv = (val_mv * 600 * 6) / 4095;

	if (val_mv < 0) {
		val_mv = 0;
	} else if (val_mv > 5000) {
		// Sanity check (max realistic battery voltage)
		val_mv = 5000;
	}

	*voltage_mv = (uint16_t)val_mv;

	LOG_DBG("ADC raw: %d, Voltage: %u mV", sample_buffer, *voltage_mv);

	return 0;
}

uint8_t battery_voltage_to_percent(uint16_t voltage_mv)
{
	// Li-Ion/LiPo voltage curve (simplified linear segments)
	// Full charge: 4.2V → 100%
	// Nominal: 3.7V → 80%
	// Low: 3.3V → 20%
	// Critical: 3.0V → 5%
	// Dead: <2.7V → 0%

	if (voltage_mv >= 4200) {
		return 100;
	} else if (voltage_mv >= 3700) {
		// 3.7V - 4.2V: 80% - 100% (linear)
		return 80 + ((voltage_mv - 3700) * 20) / 500;
	} else if (voltage_mv >= 3300) {
		// 3.3V - 3.7V: 20% - 80% (linear)
		return 20 + ((voltage_mv - 3300) * 60) / 400;
	} else if (voltage_mv >= 3000) {
		// 3.0V - 3.3V: 5% - 20% (linear)
		return 5 + ((voltage_mv - 3000) * 15) / 300;
	} else if (voltage_mv >= 2700) {
		// 2.7V - 3.0V: 0% - 5% (linear)
		return ((voltage_mv - 2700) * 5) / 300;
	} else {
		return 0;
	}
}

uint8_t battery_get_percentage(void)
{
	uint16_t voltage_mv;
	int err;

	err = battery_adc_read_mv(&voltage_mv);
	if (err) {
		LOG_WRN("Failed to read battery voltage, using default 85%%");
		return 85;  // Fallback value
	}

	uint8_t percent = battery_voltage_to_percent(voltage_mv);
	
	LOG_DBG("Battery: %u mV = %u%%", voltage_mv, percent);

	return percent;
}
```

## src/model_handler.c
```c
/*
 * Copyright (c) 2019 Nordic Semiconductor ASA
 *
 * SPDX-License-Identifier: LicenseRef-Nordic-5-Clause
 */

#include <stdio.h>

#include <zephyr/bluetooth/bluetooth.h>
#include <bluetooth/mesh/models.h>
#include <dk_buttons_and_leds.h>

#include <zephyr/shell/shell.h>
#include <zephyr/shell/shell_uart.h>
#include "chat_cli.h"
#include "model_handler.h"
#include <stdlib.h>
#include <zephyr/logging/log.h>
// Extern DSDV routing table from chat_cli.c
extern struct dsdv_route_entry g_dsdv_routes[];
#define DSDV_ROUTE_TABLE_SIZE 64
LOG_MODULE_DECLARE(chat);

static const struct shell *chat_shell;

/******************************************************************************/
/*************************** LED Blink Function *******************************/
/******************************************************************************/
static struct k_work_delayable led_blink_work;
static int blink_count_remaining = 0;

static void led_blink_work_handler(struct k_work *work)
{
	if (blink_count_remaining > 0) {
		// Toggle LED
		static bool led_state = false;
		if (!led_state) {
			dk_set_led_on(DK_LED1);
			led_state = true;
			k_work_reschedule(&led_blink_work, K_MSEC(1000));
		} else {
			dk_set_led_off(DK_LED1);
			led_state = false;
			blink_count_remaining--;
			if (blink_count_remaining > 0) {
				k_work_reschedule(&led_blink_work, K_MSEC(1000));
			}
		}
	}
}

void mesh_led_blink(int count)
{
	if (count <= 0) {
		return;
	}
	blink_count_remaining = count;
	k_work_reschedule(&led_blink_work, K_MSEC(1000));
}

/******************************************************************************/
/*************************** Health server setup ******************************/
/******************************************************************************/
static struct bt_mesh_health_srv health_srv = {
	.cb = NULL,
};

BT_MESH_HEALTH_PUB_DEFINE(health_pub, 0);

/******************************************************************************/
/***************************** Chat model setup *******************************/
/******************************************************************************/
struct metrics_cache_entry
{
	uint16_t src_addr;
	uint16_t about_addr;
	struct bt_mesh_network_metrics last_metrics;
	uint32_t measurement_count;
	uint32_t last_latency_us;  // Store calculated latency
};
static struct metrics_cache_entry metrics_cache[16];  // 4x4 nodes max

// Relay metrics cache - stores metrics from intermediate nodes
struct relay_metrics_cache_entry
{
	uint16_t relay_addr;           // Address of relay node
	uint16_t original_src;         // Original packet source
	uint32_t original_seq;         // Original packet sequence
	struct bt_mesh_network_metrics relay_metrics;  // Full relay node metrics
	uint32_t timestamp;            // When received
	uint8_t measurement_count;     // How many times seen
};
static struct relay_metrics_cache_entry relay_cache[16];  // Store up to 16 relay metrics

static void store_relay_metrics_to_cache(uint16_t relay_addr, 
                                         uint16_t original_src,
                                         uint32_t original_seq,
                                         const struct bt_mesh_network_metrics *metrics)
{
    // Find existing entry for this relay node
    for (int i = 0; i < ARRAY_SIZE(relay_cache); i++) {
        if (relay_cache[i].relay_addr == relay_addr && 
            relay_cache[i].original_src == original_src) {
            // Update existing entry
            relay_cache[i].original_seq = original_seq;
            relay_cache[i].relay_metrics = *metrics;
            relay_cache[i].timestamp = k_uptime_get_32();
            relay_cache[i].measurement_count++;
            return;
        }
    }
    
    // Find empty slot
    for (int i = 0; i < ARRAY_SIZE(relay_cache); i++) {
        if (relay_cache[i].relay_addr == 0) {
            relay_cache[i].relay_addr = relay_addr;
            relay_cache[i].original_src = original_src;
            relay_cache[i].original_seq = original_seq;
            relay_cache[i].relay_metrics = *metrics;
            relay_cache[i].timestamp = k_uptime_get_32();
            relay_cache[i].measurement_count = 1;
            return;
        }
    }
    
    // Cache full - use LRU replacement (find oldest)
    int oldest_idx = 0;
    uint32_t oldest_time = relay_cache[0].timestamp;
    for (int i = 1; i < ARRAY_SIZE(relay_cache); i++) {
        if (relay_cache[i].timestamp < oldest_time) {
            oldest_idx = i;
            oldest_time = relay_cache[i].timestamp;
        }
    }
    
    // Replace oldest entry
    relay_cache[oldest_idx].relay_addr = relay_addr;
    relay_cache[oldest_idx].original_src = original_src;
    relay_cache[oldest_idx].original_seq = original_seq;
    relay_cache[oldest_idx].relay_metrics = *metrics;
    relay_cache[oldest_idx].timestamp = k_uptime_get_32();
    relay_cache[oldest_idx].measurement_count = 1;
}

static void store_metrics_to_cache(const struct bt_mesh_network_metrics *metrics)
{
    // Tìm hoặc tạo entry trong cache
    for (int i = 0; i < ARRAY_SIZE(metrics_cache); i++) {
        if (metrics_cache[i].src_addr == metrics->src_addr && 
            metrics_cache[i].about_addr == metrics->about_addr) {
            // Update existing entry
            metrics_cache[i].last_metrics = *metrics;
            metrics_cache[i].measurement_count++;
            return;
        }
    }
    
    // Tìm empty slot
    for (int i = 0; i < ARRAY_SIZE(metrics_cache); i++) {
        if (metrics_cache[i].src_addr == 0) {
            metrics_cache[i].src_addr = metrics->src_addr;
            metrics_cache[i].about_addr = metrics->about_addr;
            metrics_cache[i].last_metrics = *metrics;
            metrics_cache[i].measurement_count = 1;
            return;
        }
    }
}

static void update_latency_in_cache(uint16_t target_addr, uint32_t latency_us)
{
    for (int i = 0; i < ARRAY_SIZE(metrics_cache); i++) {
        if (metrics_cache[i].about_addr == target_addr) {
            metrics_cache[i].last_latency_us = latency_us;
            return;
        }
    }
}

static void print_client_status(void);

static void handle_chat_start(struct bt_mesh_chat_cli *chat)
{
    /* keep silent on start */
}
static void handle_network_metrics(struct bt_mesh_chat_cli *chat,
					struct bt_mesh_msg_ctx *ctx,
					const struct bt_mesh_network_metrics *metrics)
{
	// Calculate TTL-based hops for comparison
	uint8_t ttl_final = (ctx->recv_ttl <= metrics->initial_ttl) ? ctx->recv_ttl : metrics->initial_ttl;
	uint8_t ttl_hops = metrics->initial_ttl - ttl_final;
	
	// Get latency from cache if available
	uint32_t latency_ms = 0;
	for (int i = 0; i < ARRAY_SIZE(metrics_cache); i++) {
		if (metrics_cache[i].src_addr == metrics->src_addr) {
			latency_ms = metrics_cache[i].last_latency_us / 1000;
			break;
		}
	}
	
	// Print concise ASCII-only metrics
	shell_print(chat_shell, "NETWORK METRICS");
	shell_print(chat_shell, "From: 0x%04X  About: 0x%04X", metrics->src_addr, metrics->about_addr);
	shell_print(chat_shell, "TTL: %u/%u (TTL-hops: %u) | Congestion: %u | Req-ACK: %u",
				metrics->initial_ttl, ttl_final, ttl_hops, metrics->congestion, metrics->request_ack);
	shell_print(chat_shell, "Timestamp: %u ms | Method: %s",
				metrics->timestamp, (metrics->hop_count == ttl_hops) ? "Consistent" : "Incremental");
	
	// Display neighbor RSSI if available
	if (metrics->neighbor_count > 0) {
		shell_print(chat_shell, "Neighbors (%u):", metrics->neighbor_count);
		for (int i = 0; i < metrics->neighbor_count; i++) {
			shell_print(chat_shell, "  0x%04X: %d dBm", 
			            metrics->neighbor_rssi[i].addr,
			            metrics->neighbor_rssi[i].rssi);
		}
	}
	
	store_metrics_to_cache(metrics);
}					
static void handle_metrics_ack(struct bt_mesh_chat_cli *chat,
				  struct bt_mesh_msg_ctx *ctx,
				  const struct bt_mesh_metrics_ack *ack)
{
	// Find in cache
	uint32_t current_time = k_uptime_get_32();
	uint32_t rtt = current_time - ack->original_timestamp;
	uint32_t latency = rtt/2;
	shell_print(chat_shell,
			"[LATENCY] To 0x%04X: RTT %d ms, Estimated latency %d ms",
			ack->src_addr, rtt, latency);
	update_latency_in_cache(ack->src_addr, latency);
};

// Public function to store relay metrics (called from chat_cli.c)
void store_relay_metrics(uint16_t relay_addr, 
                        uint16_t original_src,
                        uint32_t original_seq,
                        const struct bt_mesh_network_metrics *metrics)
{
	store_relay_metrics_to_cache(relay_addr, original_src, original_seq, metrics);
	LOG_INF("Stored relay metrics from 0x%04x (src=0x%04x, seq=%u)", 
	        relay_addr, original_src, (unsigned)original_seq);
}

static const struct bt_mesh_chat_cli_handlers chat_handlers = {
	.start = handle_chat_start,
	.network_metrics = handle_network_metrics,
	.metrics_ack = handle_metrics_ack,
};

/* .. include_startingpoint_model_handler_rst_1 */
static struct bt_mesh_chat_cli chat = {
	.handlers = &chat_handlers,
};

static struct bt_mesh_elem elements[] = {
	BT_MESH_ELEM(
		1,
		BT_MESH_MODEL_LIST(
			BT_MESH_MODEL_CFG_SRV,
			BT_MESH_MODEL_HEALTH_SRV(&health_srv, &health_pub)),
		BT_MESH_MODEL_LIST(BT_MESH_MODEL_CHAT_CLI(&chat))),
};
/* .. include_endpoint_model_handler_rst_1 */

static void print_client_status(void)
{
	if (!bt_mesh_is_provisioned()) {
		shell_print(chat_shell,
			    "The mesh node is not provisioned. Please provision the mesh node before using the chat.");
	} else {
		shell_print(chat_shell,
			    "The mesh node is provisioned. The client address is 0x%04x.",
			    bt_mesh_model_elem(chat.model)->rt->addr);
	}
}

static const struct bt_mesh_comp comp = {
	.cid = CONFIG_BT_COMPANY_ID,
	.elem = elements,
	.elem_count = ARRAY_SIZE(elements),
};

/******************************************************************************/
/******************************** Chat shell **********************************/
/******************************************************************************/
static int cmd_status(const struct shell *shell, size_t argc, char *argv[])
{
	print_client_status();

	return 0;
}

static int cmd_metrics_to(const struct shell *shell, size_t argc, char *argv[])
{
    uint16_t target_addr;
    int err;

    if (argc < 2) {
        shell_error(shell, "Usage: metrics_to <addr>");
        return -EINVAL;
    }

    target_addr = strtol(argv[1], NULL, 0);

    if (target_addr == 0 || target_addr > 0x7FFF) {
        shell_error(shell, "Invalid target address: 0x%04X", target_addr);
        return -EINVAL;
    }

    err = bt_mesh_chat_cli_metrics_send(&chat, target_addr);
    if (err) {
        shell_error(shell, "Failed to send metrics to 0x%04X: %d", target_addr, err);
        return err;
    }

    /* success: silent */
    return 0;
}

static int cmd_structure_to(const struct shell *shell, size_t argc, char *argv[])
{
    uint16_t target_addr;
    int err;

    if (argc < 2) {
        shell_error(shell, "Usage: structure_to <addr>");
        return -EINVAL;
    }

    target_addr = strtol(argv[1], NULL, 0);

    if (target_addr == 0 || target_addr > 0x7FFF) {
        shell_error(shell, "Invalid target address: 0x%04X", target_addr);
        return -EINVAL;
    }

    err = bt_mesh_chat_cli_structure_request(&chat, target_addr);
    if (err) {
        shell_error(shell, "Failed to request structure from 0x%04X: %d", target_addr, err);
        return err;
    }

    shell_print(shell, "Structure request sent to 0x%04X", target_addr);
    return 0;
}

static int cmd_show_routes(const struct shell *shell, size_t argc, char *argv[])
{
    shell_print(shell, "DSDV Routing Table:");
    shell_print(shell, "Dest   Next   Hops  Seq      Age(s)");
    shell_print(shell, "------------------------------------");
    
    uint32_t now = k_uptime_get_32();
    int count = 0;
    
    for (int i = 0; i < DSDV_ROUTE_TABLE_SIZE; ++i) {
        if (g_dsdv_routes[i].dest != 0) {
            uint32_t age_sec = (now - g_dsdv_routes[i].last_update_time) / 1000;
            shell_print(shell, "0x%04x 0x%04x %4u  %-8u %u",
                g_dsdv_routes[i].dest,
                g_dsdv_routes[i].next_hop,
                g_dsdv_routes[i].hop_count,
                (unsigned)g_dsdv_routes[i].seq_num,
                age_sec);
            count++;
        }
    }
    
    if (count == 0) {
        shell_print(shell, "(No routes available)");
    } else {
        shell_print(shell, "Total: %d routes", count);
    }
    return 0;
}

static int cmd_verify_route(const struct shell *shell, size_t argc, char *argv[])
{
    if (argc < 2) {
        shell_error(shell, "Usage: verify_route <dest_addr>");
        return -EINVAL;
    }
    
    uint16_t dest = strtol(argv[1], NULL, 0);
    
    // Find route
    struct dsdv_route_entry *route = NULL;
    for (int i = 0; i < DSDV_ROUTE_TABLE_SIZE; ++i) {
        if (g_dsdv_routes[i].dest == dest) {
            route = &g_dsdv_routes[i];
            break;
        }
    }
    
    if (!route) {
        shell_error(shell, "No route to 0x%04x", dest);
        return -ENOENT;
    }
    
    shell_print(shell, "Route to 0x%04x:", dest);
    shell_print(shell, "  Next hop: 0x%04x", route->next_hop);
    shell_print(shell, "  Hop count: %u", route->hop_count);
    shell_print(shell, "  Sequence: %u", (unsigned)route->seq_num);
    shell_print(shell, "  Age: %u seconds", 
                (k_uptime_get_32() - route->last_update_time) / 1000);
    shell_print(shell, "");
    shell_print(shell, "Now sending metrics to verify actual path...");
    
    // Send metrics để verify
    int err = bt_mesh_chat_cli_metrics_send(&chat, dest);
    if (err) {
        shell_error(shell, "Failed to send verification metrics: %d", err);
        return err;
    }
    
    shell_print(shell, "Check destination log for path vector to verify");
    shell_print(shell, "Expected first hop: 0x%04x", route->next_hop);
    
    return 0;
}

static int cmd_neighbor_rssi(const struct shell *shell, size_t argc, char **argv)
{
    uint16_t addrs[16];
    int8_t rssi[16];
    
    int count = bt_mesh_chat_cli_get_neighbor_rssi(addrs, rssi, 16);
    
    if (count == 0) {
        shell_print(shell, "No neighbor RSSI data available");
        return 0;
    }
    
    shell_print(shell, "Neighbor RSSI (last 60s):");
    shell_print(shell, "Address  | RSSI (dBm)");
    shell_print(shell, "---------|------------");
    
    for (int i = 0; i < count; i++) {
        shell_print(shell, "0x%04x   | %d", addrs[i], rssi[i]);
    }
    
    return 0;
}

static int cmd_clear_history(const struct shell *shell, size_t argc, char **argv)
{
    bt_mesh_chat_cli_clear_route_history();
    shell_print(shell, "Route metrics history cleared");
    return 0;
}

static int cmd_show_history(const struct shell *shell, size_t argc, char **argv)
{
    bt_mesh_chat_cli_show_route_history();
    return 0;
}

static int cmd_show_relay_metrics(const struct shell *shell, size_t argc, char **argv)
{
    uint8_t count = 0;
    
    // Count valid entries
    for (int i = 0; i < ARRAY_SIZE(relay_cache); i++) {
        if (relay_cache[i].relay_addr != 0) {
            count++;
        }
    }
    
    if (count == 0) {
        shell_print(shell, "No relay metrics available");
        return 0;
    }
    
    shell_print(shell, "\n=== RELAY METRICS CACHE (%u entries) ===", count);
    shell_print(shell, "");
    
    for (int i = 0; i < ARRAY_SIZE(relay_cache); i++) {
        if (relay_cache[i].relay_addr == 0) {
            continue;  // Skip empty slot
        }
        
        struct relay_metrics_cache_entry *entry = &relay_cache[i];
        struct bt_mesh_network_metrics *m = &entry->relay_metrics;
        
        // Calculate weak node percentage
        uint8_t weak_node_pct = 0;
        if (m->neighbor_count > 0) {
            uint8_t weak_count = 0;
            for (int j = 0; j < m->neighbor_count; j++) {
                if (m->neighbor_rssi[j].rssi < -80) {
                    weak_count++;
                }
            }
            weak_node_pct = (weak_count * 100) / m->neighbor_count;
        }
        
        // Calculate age
        uint32_t age_s = (k_uptime_get_32() - entry->timestamp) / 1000;
        
        shell_print(shell, "Relay Node: 0x%04x (src=0x%04x, seq=%u, count=%u, age=%us)",
                    entry->relay_addr, entry->original_src, 
                    (unsigned)entry->original_seq, entry->measurement_count, age_s);
        shell_print(shell, " Neighbors: %u | Weak: %u%% | Congestion: %u‰", m->neighbor_count, weak_node_pct, m->congestion);
        
        if (m->neighbor_count > 0) {
            shell_print(shell, "  Neighbors RSSI:");
            for (int j = 0; j < m->neighbor_count; j++) {
                shell_print(shell, "    0x%04x: %d dBm%s",
                            m->neighbor_rssi[j].addr,
                            m->neighbor_rssi[j].rssi,
                            (m->neighbor_rssi[j].rssi < -80) ? " (WEAK)" : "");
            }
        }
        shell_print(shell, "");
    }
    
    return 0;
}

SHELL_STATIC_SUBCMD_SET_CREATE(chat_cmds,
	SHELL_CMD_ARG(status, NULL, "Print client status", cmd_status, 1, 0),
	SHELL_CMD_ARG(metrics_to, NULL, "Send metrics to specific node <addr> via DSDV",
		      cmd_metrics_to, 2, 0),
	SHELL_CMD_ARG(structure_to, NULL, "Request network structure from node <addr>",
		      cmd_structure_to, 2, 0),
	SHELL_CMD_ARG(routes, NULL,"Show DSDV routing table",cmd_show_routes, 1, 0),
	SHELL_CMD_ARG(verify_route, NULL, "Verify route to <addr> by sending metrics",
		      cmd_verify_route, 2, 0),
	SHELL_CMD_ARG(neighbors, NULL, "Show per-neighbor RSSI",
		      cmd_neighbor_rssi, 1, 0),
	SHELL_CMD_ARG(clear_history, NULL, "Clear route metrics history",
		      cmd_clear_history, 1, 0),
	SHELL_CMD_ARG(show_history, NULL, "Show route metrics comparison table",
		      cmd_show_history, 1, 0),
	SHELL_CMD_ARG(relay_metrics, NULL, "Show relay node metrics cache",
		      cmd_show_relay_metrics, 1, 0),
	SHELL_SUBCMD_SET_END
);

static int cmd_chat(const struct shell *shell, size_t argc, char **argv)
{
	if (argc == 1) {
		shell_help(shell);
		/* shell returns 1 when help is printed */
		return 1;
	}

	shell_error(shell, "%s unknown parameter: %s", argv[0], argv[1]);

	return -EINVAL;
}

SHELL_CMD_ARG_REGISTER(chat, &chat_cmds, "Bluetooth Mesh Chat Client commands",
		       cmd_chat, 1, 1);

/******************************************************************************/
/******************************** Public API **********************************/
/******************************************************************************/
const struct bt_mesh_comp *model_handler_init(void)
{
	chat_shell = shell_backend_uart_get_ptr();
	
	// Initialize LED blink work queue
	k_work_init_delayable(&led_blink_work, led_blink_work_handler);

	return &comp;
}
```
